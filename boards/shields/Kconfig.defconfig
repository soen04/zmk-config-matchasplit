## boards/shields/Kconfig.defconfig
```kconfig
if SHIELD_matchasplit_LEFT

config ZMK_KEYBOARD_NAME
    default "matchasplit"

config ZMK_SPLIT_ROLE_CENTRAL
    default y

endif

if SHIELD_matchasplit_LEFT || SHIELD_matchasplit_RIGHT

config ZMK_SPLIT
    default y

endif
```

## boards/shields/Kconfig.shield
```kconfig
# Copyright (c) 2020 Pete Johanson
# SPDX-License-Identifier: MIT

config SHIELD_MATCHASPLIT_LEFT
    def_bool $(shields_list_contains,matchasplit_left)

config SHIELD_MATCHASPLIT_RIGHT
    def_bool $(shields_list_contains,matchasplit_right)
```
