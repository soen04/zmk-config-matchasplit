/*
 * Copyright (c) 2020 Pete Johanson
 *
 * SPDX-License-Identifier: MIT
 */

#include "matchasplit.dtsi"

&kscan0 {
    col-gpios
        = <&gpio0 06 GPIO_ACTIVE_LOW>
        , <&gpio0 04 GPIO_ACTIVE_LOW>
        , <&gpio0 11 GPIO_ACTIVE_LOW>
        , <&gpio0 24 GPIO_ACTIVE_LOW>
        , <&gpio0 22 GPIO_ACTIVE_LOW>
        , <&gpio0 20 GPIO_ACTIVE_LOW>
        , <&gpio0 17 GPIO_ACTIVE_LOW>
        ;
};

&left_encoder {
    status = "okay";
};