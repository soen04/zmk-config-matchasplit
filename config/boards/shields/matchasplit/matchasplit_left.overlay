/*
 * Copyright (c) 2020 Pete Johanson
 *
 * SPDX-License-Identifier: MIT
 */

#include "matchasplit.dtsi"

&kscan0 {
    col-gpios
        = <&gpio0 106 GPIO_ACTIVE_LOW>
        , <&gpio0 104 GPIO_ACTIVE_LOW>
        , <&gpio0 11 GPIO_ACTIVE_LOW>
        , <&gpio0 100 GPIO_ACTIVE_LOW>
        , <&gpio0 24 GPIO_ACTIVE_LOW>
        , <&gpio0 22 GPIO_ACTIVE_LOW>
        , <&gpio0 20 GPIO_ACTIVE_LOW>
        ;
};

&left_encoder {
    status = "okay";
};